#include "test.h"

//---------------U8g2测试函数

#define SEND_BUFFER_DISPLAY_MS(u8g2, ms)\
  do {\
    u8g2_SendBuffer(u8g2); \
    HAL_Delay(ms);\
  }while(0);

// 学号和姓名信息
const char* student_id = "632307030403";
const char* student_name = "zhengjiabao";

// 自定义头像图案 (16x16像素)
const unsigned char avatar_bits[] U8X8_PROGMEM = {
  0x00, 0x00, 0x00, 0x00, 0x00, 0x00, 0x00, 0x00, 
  0x00, 0x00, 0x00, 0x00, 0x00, 0x00, 0x00, 0x00,
  0x00, 0x00, 0x00, 0x00, 0x00, 0x00, 0x00, 0x00,
  0x00, 0x00, 0x00, 0x00, 0x00, 0x00, 0x00, 0x00
};

// 笑脸图案 (32x32像素)
const unsigned char smiley_face[] U8X8_PROGMEM = {
  0x00, 0x00, 0x00, 0x00, 0x00, 0x00, 0x00, 0x00, 
  0x00, 0x00, 0x00, 0x00, 0x00, 0x00, 0x00, 0x00,
  0x00, 0x00, 0x00, 0x00, 0x00, 0x00, 0x00, 0x00,
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  0x00, 0x00, 0x00, 0x00, 0x00, 0x00, 0x00, 0x00
};

// 1. 显示学号和姓名
void showStudentInfo(u8g2_t *u8g2)
{
    u8g2_ClearBuffer(u8g2);
    
    // 设置大字体显示学号
    u8g2_SetFont(u8g2, u8g2_font_ncenB14_tf);
    u8g2_DrawStr(u8g2, 10, 20, student_id);
    
    // 设置中等字体显示姓名
    u8g2_SetFont(u8g2, u8g2_font_ncenB10_tf);
    u8g2_DrawStr(u8g2, 25, 40, student_name);
    
    SEND_BUFFER_DISPLAY_MS(u8g2, 2000);
}

// 2. 上下滑动显示效果
void verticalScrollText(u8g2_t *u8g2, const char* text)
{
    int text_width = u8g2_GetStrWidth(u8g2, text);
    int x_pos = 64 - text_width/2; // 居中
    
    // 从底部向上滑动
    for(int y = 64; y >= 20; y -= 2) {
        u8g2_ClearBuffer(u8g2);
        u8g2_SetFont(u8g2, u8g2_font_ncenB12_tf);
        u8g2_DrawStr(u8g2, x_pos, y, text);
        u8g2_SendBuffer(u8g2);
        HAL_Delay(30);
    }
    
    HAL_Delay(1000);
    
    // 从当前位置向下滑动消失
    for(int y = 20; y <= 64; y += 2) {
        u8g2_ClearBuffer(u8g2);
        u8g2_SetFont(u8g2, u8g2_font_ncenB12_tf);
        u8g2_DrawStr(u8g2, x_pos, y, text);
        u8g2_SendBuffer(u8g2);
        HAL_Delay(30);
    }
}

// 3. 左右滑动显示效果
void horizontalScrollText(u8g2_t *u8g2, const char* text)
{
    int text_width = u8g2_GetStrWidth(u8g2, text);
    
    // 从右侧滑入
    for(int x = 128; x >= 64 - text_width/2; x -= 3) {
        u8g2_ClearBuffer(u8g2);
        u8g2_SetFont(u8g2, u8g2_font_ncenB12_tf);
        u8g2_DrawStr(u8g2, x, 32, text);
        u8g2_SendBuffer(u8g2);
        HAL_Delay(30);
    }
    
    HAL_Delay(1000);
    
    // 向左滑动消失
    for(int x = 64 - text_width/2; x >= -text_width; x -= 3) {
        u8g2_ClearBuffer(u8g2);
        u8g2_SetFont(u8g2, u8g2_font_ncenB12_tf);
        u8g2_DrawStr(u8g2, x, 32, text);
        u8g2_SendBuffer(u8g2);
        HAL_Delay(30);
    }
}

// 4. 动态笑脸图案 - 眨眼动画
void animateSmileyFace(u8g2_t *u8g2)
{
    int center_x = 64;
    int center_y = 32;
    int radius = 20;
    
    // 画几个不同状态的笑脸
    for(int frame = 0; frame < 3; frame++) {
        u8g2_ClearBuffer(u8g2);
        
        // 画脸轮廓
        u8g2_DrawCircle(u8g2, center_x, center_y, radius, U8G2_DRAW_ALL);
        
        // 眼睛
        if(frame == 1) {
            // 眨眼状态 - 画线表示闭眼
            u8g2_DrawLine(u8g2, center_x-8, center_y-5, center_x-3, center_y-5);
            u8g2_DrawLine(u8g2, center_x+8, center_y-5, center_x+3, center_y-5);
        } else {
            // 正常状态 - 画圆眼睛
            u8g2_DrawDisc(u8g2, center_x-6, center_y-5, 3, U8G2_DRAW_ALL);
            u8g2_DrawDisc(u8g2, center_x+6, center_y-5, 3, U8G2_DRAW_ALL);
        }
        
        // 嘴巴 - 微笑
        u8g2_DrawDisc(u8g2, center_x, center_y+5, 8, U8G2_DRAW_UPPER_LEFT);
        u8g2_DrawDisc(u8g2, center_x, center_y+5, 8, U8G2_DRAW_UPPER_RIGHT);
        
        u8g2_SendBuffer(u8g2);
        HAL_Delay(500);
    }
}

// 5. 旋转方块动画
void rotateSquareAnimation(u8g2_t *u8g2)
{
    int center_x = 64;
    int center_y = 32;
    int size = 15;
    
    for(int angle = 0; angle < 360; angle += 10) {
        u8g2_ClearBuffer(u8g2);
        
        // 计算旋转后的四个顶点
        float rad = angle * 3.14159 / 180.0;
        int x1 = center_x + (int)(size * cos(rad) - size * sin(rad));
        int y1 = center_y + (int)(size * sin(rad) + size * cos(rad));
        int x2 = center_x + (int)(-size * cos(rad) - size * sin(rad));
        int y2 = center_y + (int)(-size * sin(rad) + size * cos(rad));
        int x3 = center_x + (int)(-size * cos(rad) + size * sin(rad));
        int y3 = center_y + (int)(-size * sin(rad) - size * cos(rad));
        int x4 = center_x + (int)(size * cos(rad) + size * sin(rad));
        int y4 = center_y + (int)(size * sin(rad) - size * cos(rad));
        
        // 画旋转的方块
        u8g2_DrawLine(u8g2, x1, y1, x2, y2);
        u8g2_DrawLine(u8g2, x2, y2, x3, y3);
        u8g2_DrawLine(u8g2, x3, y3, x4, y4);
        u8g2_DrawLine(u8g2, x4, y4, x1, y1);
        
        u8g2_SendBuffer(u8g2);
        HAL_Delay(50);
    }
}

// 6. 弹跳球动画
void bouncingBallAnimation(u8g2_t *u8g2)
{
    int ball_x = 20;
    int ball_y = 10;
    int ball_radius = 5;
    int velocity_y = 2;
    int gravity = 1;
    
    for(int frame = 0; frame < 100; frame++) {
        u8g2_ClearBuffer(u8g2);
        
        // 更新球的位置
        ball_y += velocity_y;
        velocity_y += gravity;
        
        // 碰到底部反弹
        if(ball_y + ball_radius > 60) {
            ball_y = 60 - ball_radius;
            velocity_y = -velocity_y * 0.8; // 能量损失
        }
        
        // 画球
        u8g2_DrawDisc(u8g2, ball_x, ball_y, ball_radius, U8G2_DRAW_ALL);
        
        // 画地面
        u8g2_DrawLine(u8g2, 0, 62, 127, 62);
        
        u8g2_SendBuffer(u8g2);
        HAL_Delay(30);
        
        // 球向右移动
        ball_x += 1;
        if(ball_x > 127) ball_x = 20;
    }
}

// 进度条显示 (原有函数保留)
void testDrawProcess(u8g2_t *u8g2)
{
	for(int i=10;i<=80;i=i+2)
	{
		u8g2_ClearBuffer(u8g2); 
			
		char buff[20];
		sprintf(buff,"%d%%",(int)(i/80.0*100));
		
		u8g2_SetFont(u8g2,u8g2_font_ncenB12_tf);
		u8g2_DrawStr(u8g2,16,32,"STM32 U8g2");
		
		u8g2_SetFont(u8g2,u8g2_font_ncenB08_tf);
		u8g2_DrawStr(u8g2,100,49,buff);
		
		u8g2_DrawRBox(u8g2,16,40,i,10,4);
		u8g2_DrawRFrame(u8g2,16,40,80,10,4);
		
		u8g2_SendBuffer(u8g2);
	}
	HAL_Delay(500);
}

// 字体测试 (原有函数保留)
void testShowFont(u8g2_t *u8g2)
{
	int t = 1000;
	char testStr[14] = "STM32F103C8T6";
	
	u8g2_ClearBuffer(u8g2);
	
	u8g2_SetFont(u8g2,u8g2_font_u8glib_4_tf);
	u8g2_DrawStr(u8g2,0,5,testStr);
	SEND_BUFFER_DISPLAY_MS(u8g2,t);
	
	u8g2_SetFont(u8g2,u8g2_font_ncenB08_tf);
	u8g2_DrawStr(u8g2,0,30,testStr);
	SEND_BUFFER_DISPLAY_MS(u8g2,t);
	
    u8g2_SetFont(u8g2,u8g2_font_ncenB10_tr);
	u8g2_DrawStr(u8g2,0,60,testStr);
	SEND_BUFFER_DISPLAY_MS(u8g2,t);
}

// width: 128, height: 48
const unsigned char bilibili[] U8X8_PROGMEM = { 0x00, 0x00, 0x00, 0x00, 0x00, 0x00, 0x00, 0x00, 0x00, 0x00, 0x00, 0x00, 0x00,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 0x00, 0x00 };
// width: 128, height: 48
const unsigned char three_support[] U8X8_PROGMEM = { 0x00, 0x00, 0x00, 0x00, 0x00, 0x00, 0x00, 0x00, 0x00, 0x00, 0x00, 0x00, 0x00,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 0x00, 0x00 };

// XBM显示 (原有函数保留)
void testDrawXBM(u8g2_t *u8g2)
{
	int t = 1000;
	u8g2_ClearBuffer(u8g2);
	u8g2_DrawStr(u8g2,0, 14, "DrawXBM");

	u8g2_DrawXBM(u8g2,0, 16, 128, 48, bilibili);
	SEND_BUFFER_DISPLAY_MS(u8g2,t);

	u8g2_ClearBuffer(u8g2);
	u8g2_DrawStr(u8g2,0, 14, "bilibili");
	u8g2_DrawXBM(u8g2,0, 16, 128, 48, three_support);
	SEND_BUFFER_DISPLAY_MS(u8g2,t);
}

// 新的综合测试函数
void u8g2DrawTest(u8g2_t *u8g2)
{
    // 1. 显示学号和姓名
    showStudentInfo(u8g2);
    
    // 2. 上下滑动效果
    verticalScrollText(u8g2, "Hello U8g2!");
    
    // 3. 左右滑动效果  
    horizontalScrollText(u8g2, "Sliding Text");
    
    // 4. 动态笑脸图案
    animateSmileyFace(u8g2);
    
    // 5. 旋转方块动画
    rotateSquareAnimation(u8g2);
    
    // 6. 弹跳球动画
    bouncingBallAnimation(u8g2);
    
    // 原有的测试函数
    testDrawProcess(u8g2);
    testShowFont(u8g2);
    testDrawXBM(u8g2);
}